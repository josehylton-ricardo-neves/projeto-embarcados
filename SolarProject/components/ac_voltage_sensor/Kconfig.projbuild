## SolarProject/components/ac_voltage_sensor/Kconfig.projbuild
```kconfig
menu "AC VOLTAGE SENSOR Configuration"

    config AC_VOLTAGE_SENSOR
        int "AC VOLTAGE SENSOR GPIO number"
        default 33
        help
            GPIO number to connect ac voltage sensor.

endmenu
```

## SolarProject/components/acs712/Kconfig.projbuild
```kconfig
menu "ACS712 SENSOR Configuration"

    config ACS712_ADC_CHANNEL
        int "ADC1 Channel to connect ACS712 sensor"
        default 6
        help
            ADC CHANNEL to connect acs712 sensor in this project you need to use ADC1_CHANNEL to avoid some problems 
			because the WIFI module use some ADC2_CHANNEL.

endmenu
```

## SolarProject/components/all_components_interface/Kconfig.projbuild
```kconfig
menu "BATTERY Configuration"

    config MIN_BATTERY_VOLTAGE
        int "Minimum battery voltage"
        default 10
        help
            Minimum battery voltage configuration.
			
	config MAX_BATTERY_VOLTAGE
        int "Maximum battery voltage"
        default 14
        help
            Maximum battery voltage configuration.

	config MAX_BATTERY_TEMPERATURE
        int "Maximum battery temperature in ºC"
        default 27
        help
            Maximum battery temperature configuration in ºC.

endmenu
```

## SolarProject/components/dc_voltage_sensor/Kconfig.projbuild
```kconfig
menu "DC VOLTAGE SENSOR Configuration"

    config DC_VOLTAGE_SENSOR
        int "ADC1 Channel to connect DC VOLTAGE SENSOR"
        default 7
        help
            ADC CHANNEL to connect dc voltage sensor in this project you need to use ADC1_CHANNEL to avoid some problems 
			because the WIFI module use some ADC2_CHANNEL.

endmenu
```

## SolarProject/components/ds18b20_interface/Kconfig.projbuild
```kconfig
menu "DS18B20 SENSOR Configuration"

config DS18B20_ONE_WIRE_GPIO
    int "DS18B20 OneWire GPIO number"
	default 32
	help
		GPIO number (IOxx) to access One Wire Bus.

		Some GPIOs are used for other purposes (flash connections, etc.) and cannot be used.

		GPIOs 34-39 are input-only so cannot be used to drive the One Wire Bus.

endmenu
```

## SolarProject/components/mqtt_implement/Kconfig.projbuild
```kconfig
menu "MQTT Connection Configuration"

    config BROKER_HOST
        string "Broker Host"
        default ""
        help
            host(ip) adress to connect the broker
    
    config BROKER_PORT
        int "Broker port"
        default 1883
        help
            Port number to connect the Broker

    config BROKER_USERNAME
        string "Broker Username"
        default ""
        help
            Username to connect the Broker

    config BROKER_PASSWORD
        string "Broker Password"
        default ""
        help
            Password to connect the Broker

    config BROKER_URL
        string "Broker URL"
        default "mqtt://mqtt.eclipseprojects.io"
        help
            URL of the broker to connect to

    config BROKER_URL_FROM_STDIN
        bool
        default y if BROKER_URL = "FROM_STDIN"

    config BROKER_TOPIC_NAME_TO_PUBLISHER
        string "Broker topic name to publisher messages"
        default ""
        help
            Topic name on Broker to publisher messages

    config BROKER_TOPIC_NAME_TO_CONSUMER
        string "Broker topic name to consumer messages"
        default ""
        help
            Topic name on Broker to consumer messages

endmenu
```

## SolarProject/components/power_supply_driver/Kconfig.projbuild
```kconfig
menu "POWER SUPPLY Drivers"

    config AC_POWER_SUPPLY_DRIVER
        int "AC Power supply driver GPIO number"
        default 18
        help
            GPIO number to change de power supply to mains voltage.
			
	config DC_POWER_SUPPLY_DRIVER
		int "DC power supply driver GPIO number"
        default 19
        help
            GPIO number to change de power supply to baterry voltage.

endmenu
```
